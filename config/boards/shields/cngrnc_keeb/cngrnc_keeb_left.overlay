/*
 * Copyright (c) 2020 Pete Johanson
 *
 * SPDX-License-Identifier: MIT
 */

#include "cngrnc_keeb.dtsi"

&kscan0 {
	col-gpios
		= <&gpio1 11 GPIO_ACTIVE_HIGH>   //Col0
		, <&gpio0 5 GPIO_ACTIVE_HIGH>   //Col1
		, <&gpio0 4 GPIO_ACTIVE_HIGH>  //Col2
		, <&gpio0 29 GPIO_ACTIVE_HIGH>  //Col3
		, <&gpio0 28 GPIO_ACTIVE_HIGH>   //Col4
		, <&gpio0 3 GPIO_ACTIVE_HIGH>   //Col5
		, <&gpio0 2 GPIO_ACTIVE_HIGH>  //Col6
		;
};

