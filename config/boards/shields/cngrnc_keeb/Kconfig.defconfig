## config/boards/shields/cngrnc_keeb/Kconfig.defconfig
```kconfig
if SHIELD_CNGRNC_KEEB_LEFT

config ZMK_KEYBOARD_NAME
    default "congruencekeebs"

config ZMK_SPLIT_ROLE_CENTRAL
    default y

endif

if SHIELD_CNGRNC_KEEB

config ZMK_SPLIT
    default y

endif
```

## config/boards/shields/cngrnc_keeb/Kconfig.shield
```kconfig
# Copyright (c) 2020 Pete Johanson
# SPDX-License-Identifier: MIT
config SHIELD_CNGRNC_KEEB
    bool

config SHIELD_CNGRNC_KEEB_LEFT
	def_bool $(shields_list_contains,cngrnc_keeb_left)
	select SHIELD_CNGRNC_KEEB

config SHIELD_CNGRNC_KEEB_RIGHT
	def_bool $(shields_list_contains,cngrnc_keeb_right)
	select SHIELD_CNGRNC_KEEB
```
